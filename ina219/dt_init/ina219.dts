/dts-v1/;
/plugin/;

/{
 compatible = "brcm,bcm2835";

 fragment@0 {
   target = <&i2c1>;
   __overlay__ {
     #address-cells = <1>;
     #size-cells = <0>;
     status = "okay";

   ina219@40 {
          compatible = "ti,ina219";
          reg = <0x40>;
          shunt-resistor = <1000>;
     };
   };
 };
};
/dts-v1/;
/plugin/;

/{
 compatible = "brcm,bcm2835";

 fragment@0 {
   target = <&i2c1>;
   __overlay__ {
     #address-cells = <1>;
     #size-cells = <0>;
     status = "okay";

   bme680@76 {
          compatible = "bosch,bme680";
          reg = <0x77>;
     };
   };
 };
};